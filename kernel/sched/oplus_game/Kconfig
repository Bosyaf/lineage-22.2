## kernel/sched/oplus_game/Kconfig
```kconfig
config OPLUS_FEATURE_CPU_GAME
    bool "OPLUS CPU game early-detect support"
    depends on CPU_FREQ && PROC_FS && TRACEPOINTS && PM
    default n
    help
      Built-in OPLUS game early-detect and CPU frequency QoS support.
      The feature remains disabled at runtime until userspace enables it.
```
